## CMakeLists.txt
```
# add the path to the button_smf module
list(APPEND EXTRA_ZEPHYR_MODULES ${CMAKE_CURRENT_SOURCE_DIR}/../)
set(EXTRA_DTS_DIR ${CMAKE_CURRENT_LIST_DIR}/../zephyr/dts)
message(EXTRA_DTS_DIR=${EXTRA_DTS_DIR})
list(APPEND DTS_ROOT ${EXTRA_DTS_DIR})

cmake_minimum_required(VERSION 3.20.0)
find_package(Zephyr REQUIRED HINTS $ENV{ZEPHYR_BASE})

project(sample)

target_sources(app PRIVATE src/main.c)
```

## prj.conf
```kconfig
CONFIG_BUTTON_SMF=y
CONFIG_BUTTON_SMF_DEBOUNCE_TIME_MS=50
CONFIG_BUTTON_SMF_MAX_PRESSED_CALLBACKS=3
CONFIG_BUTTON_SMF_MAX_RELEASE_CALLBACKS=3
CONFIG_BUTTON_SMF_LOG_LEVEL_DBG=y

CONFIG_BUTTON_SMF_DOUBLE_CLICK=y

CONFIG_DEBUG_OPTIMIZATIONS=y

CONFIG_LOG=y
CONFIG_LOG_BACKEND_UART=y
CONFIG_LOG_MODE_IMMEDIATE=y
```

## nrf52840dk_nrf52840.overlay
```dts
/ {
    // aliases {
        //     button0 = &button-0;
    // };


    buttonsmf0: buttonsmf {
        compatible = "buttonsmf";

        input-gpios = <&gpio0 11 (GPIO_PULL_UP | GPIO_ACTIVE_LOW)>;
    };

};
```

## src/main.c
```c
#include <zephyr/kernel.h>
#include <zephyr/logging/log.h>
#include "button_smf.h"

LOG_MODULE_REGISTER(main);

void double_click(const struct device *button_smf)
{
        LOG_INF("double click!!!\n");
}

void button_pressed(const struct device *button_smf)
{
        LOG_INF("button pressed\n");
}
void button_released(const struct device *button_smf)
{
        LOG_INF("button released\n");
}

void fast_press(const struct device *button_smf)
{
        LOG_INF("fast press\n");
}

void long_press(const struct device *button_smf)
{
        LOG_INF("long press\n");
}

void longest_press(const struct device *button_smf)
{
        LOG_INF("longest press\n");
}

void fast_release(const struct device *button_smf)
{
        LOG_INF("fast release\n");
}

void long_release(const struct device *button_smf)
{
        LOG_INF("long release\n");
}

void longest_release(const struct device *button_smf)
{
        LOG_INF("longest release\n");
}

static const struct device *button_smf = DEVICE_DT_GET_ONE(buttonsmf);

int main(void)
{
        /*
                Register press callbacks.
                All callbacks will be called in order while button is pressed
                So if you press the button for 6 seconds, only fast_press and long_press will be called
        */
        LOG_INF("device is %p, name is %s", button_smf, button_smf->name);

        button_smf_register_press_cb(button_smf, fast_press, K_NO_WAIT);
        button_smf_register_press_cb(button_smf, long_press, K_SECONDS(5));
        button_smf_register_press_cb(button_smf, longest_press, K_SECONDS(10));

        /*
                Register release callbacks.
                Only the last callback (before release time) will be called
                So if you press the button for 6 seconds, only long_release will be called
        */
        button_smf_register_release_cb(button_smf, fast_release, K_NO_WAIT);
        button_smf_register_release_cb(button_smf, long_release, K_SECONDS(5));
        button_smf_register_release_cb(button_smf, longest_release, K_SECONDS(10));

        button_smf_register_double_click_callback(button_smf, double_click);

        LOG_INF("Sample app started");
        return 0;
}
```
